## config/west.yml
```yaml
manifest:
  defaults:
    revision: v0.2
  remotes:
    - name: zmkfirmware
      url-base: https://github.com/zmkfirmware
    # Forager Keyboard + Prospector
    - name: carrefinho
      url-base: https://github.com/carrefinho
    # RGB Led
    - name: caksoylar
      url-base: https://github.com/caksoylar
    # ZMK tri-state
    - name: dhruvinsh
      url-base: https://github.com/dhruvinsh
    # ZMK Dongle Screen
    - name: janpfischer
      url-base: https://github.com/janpfischer
  projects:
    - name: zmk
      remote: zmkfirmware
      revision: v0.3.0
      import: app/west.yml
    - name: forager-zmk-module-dongle
      remote: carrefinho
      revision: main
    #- name: prospector-zmk-module
    #  remote: carrefinho
    #  revision: main
    - name: zmk-rgbled-widget
      remote: caksoylar
      revision: main
    - name: zmk-tri-state
      remote: dhruvinsh
      revision: main
    - name: zmk-dongle-screen
      remote: janpfischer
      revision: reconnection_wake
  self:
    path: config
```
